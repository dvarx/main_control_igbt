/**
 * @cliArgs --board "/ti/boards/MSP_EXP432P401R" --product "simplelink_msp432p4_sdk@3.40.01.02"
 * @versions {"data":"2020052512","timestamp":"2020052512","tool":"1.5.0+1397","templates":"2020052512"}
 */

/**
 * Import the modules used in this configuration.
 */
const ADC    = scripting.addModule("/ti/drivers/ADC", {}, false);
const ADC1   = ADC.addInstance();
const GPIO   = scripting.addModule("/ti/drivers/GPIO");
const GPIO1  = GPIO.addInstance();
const GPIO2  = GPIO.addInstance();
const GPIO3  = GPIO.addInstance();
const GPIO4  = GPIO.addInstance();
const GPIO5  = GPIO.addInstance();
const GPIO6  = GPIO.addInstance();
const GPIO7  = GPIO.addInstance();
const GPIO8  = GPIO.addInstance();
const GPIO9  = GPIO.addInstance();
const GPIO10 = GPIO.addInstance();
const GPIO11 = GPIO.addInstance();
const GPIO12 = GPIO.addInstance();
const GPIO13 = GPIO.addInstance();
const GPIO14 = GPIO.addInstance();
const GPIO15 = GPIO.addInstance();
const GPIO16 = GPIO.addInstance();
const GPIO17 = GPIO.addInstance();
const GPIO18 = GPIO.addInstance();
const GPIO19 = GPIO.addInstance();
const GPIO20 = GPIO.addInstance();
const GPIO21 = GPIO.addInstance();
const GPIO22 = GPIO.addInstance();
const GPIO23 = GPIO.addInstance();
const GPIO24 = GPIO.addInstance();
const GPIO25 = GPIO.addInstance();
const GPIO26 = GPIO.addInstance();
const GPIO27 = GPIO.addInstance();
const PWM    = scripting.addModule("/ti/drivers/PWM", {}, false);
const PWM1   = PWM.addInstance();
const PWM2   = PWM.addInstance();
const PWM3   = PWM.addInstance();
const PWM4   = PWM.addInstance();
const RTOS   = scripting.addModule("/ti/drivers/RTOS");
const Timer  = scripting.addModule("/ti/drivers/Timer", {}, false);
const Timer1 = Timer.addInstance();

/**
 * Write custom configuration values to the imported modules.
 */
ADC1.$name              = "CONFIG_ADC_ISENSE";
ADC1.adc.adcPin.$assign = "boosterpack.23";

GPIO1.$name           = "CONFIG_GPIO_HEARTBEAT";
GPIO1.gpioPin.$assign = "boosterpack.40";

GPIO2.$name     = "CONFIG_GPIO_SW1";
GPIO2.$hardware = system.deviceData.board.components.S1;

GPIO3.$name     = "CONFIG_GPIO_SW2";
GPIO3.$hardware = system.deviceData.board.components.S2;

GPIO4.$name           = "CONFIG_GPIO_EN";
GPIO4.mode            = "Output";
GPIO4.gpioPin.$assign = "boosterpack.15";

GPIO5.$name           = "CONFIG_GPIO_TOP_RDY_1";
GPIO5.gpioPin.$assign = "boosterpack.39";

GPIO6.$name           = "CONFIG_GPIO_TOP_RDY_2";
GPIO6.gpioPin.$assign = "boosterpack.19";

GPIO7.$name           = "CONFIG_GPIO_BOT_RDY_1";
GPIO7.gpioPin.$assign = "boosterpack.38";

GPIO8.$name           = "CONFIG_GPIO_BOT_RDY_2";
GPIO8.gpioPin.$assign = "boosterpack.18";

GPIO9.$name           = "CONFIG_GPIO_TOP_FLT";
GPIO9.gpioPin.$assign = "boosterpack.17";

GPIO10.$name           = "CONFIG_GPIO_BTN_FLT";
GPIO10.gpioPin.$assign = "boosterpack.36";

GPIO11.$name           = "CONFIG_GPIO_SIGI";
GPIO11.gpioPin.$assign = "boosterpack.35";

GPIO12.$name           = "CONFIG_GPIO_SIGO";
GPIO12.gpioPin.$assign = "boosterpack.14";

GPIO13.$name     = "CONFIG_GPIO_LED_RED";
GPIO13.$hardware = system.deviceData.board.components.LED2_RED;

GPIO14.$name     = "CONFIG_GPIO_LED_GREEN";
GPIO14.$hardware = system.deviceData.board.components.LED2_GREEN;

GPIO15.$name     = "CONFIG_GPIO_LED_BLUE";
GPIO15.$hardware = system.deviceData.board.components.LED2_BLUE;

GPIO16.$name           = "CONFIG2_GPIO_TOP_RDY2";
GPIO16.gpioPin.$assign = "boosterpack.2";

GPIO17.$name           = "CONFIG2_GPIO_TOP_RDY1";
GPIO17.gpioPin.$assign = "boosterpack.7";

GPIO18.$name           = "CONFIG2_GPIO_BOT_RDY1";
GPIO18.gpioPin.$assign = "boosterpack.8";

GPIO19.$name           = "CONFIG2_GPIO_BOT_RDY2";
GPIO19.gpioPin.$assign = "boosterpack.4";

GPIO20.$name           = "CONFIG2_GPIO_SIGO";
GPIO20.gpioPin.$assign = "boosterpack.24";

GPIO21.$name           = "CONFIG2_GPIO_SIGI";
GPIO21.gpioPin.$assign = "boosterpack.5";

GPIO22.$name           = "CONFIG2_GPIO_TOP_FLT";
GPIO22.gpioPin.$assign = "boosterpack.25";

GPIO23.$name           = "CONFIG2_GPIO_BTN_FLT";
GPIO23.gpioPin.$assign = "boosterpack.6";

GPIO24.$name           = "CONFIG2_GPIO_EN";
GPIO24.gpioPin.$assign = "boosterpack.26";

GPIO25.$name           = "CONFIG_GPIO_TMPCLK";
GPIO25.gpioPin.$assign = "boosterpack.9";

GPIO26.$name           = "CONFIG_GPIO_TMPMEAS_A";
GPIO26.gpioPin.$assign = "boosterpack.13";

GPIO27.$name           = "CONFIG_GPIO_TMPMEAS_B";
GPIO27.gpioPin.$assign = "boosterpack.30";

PWM1.$name                = "CONFIG_PWM_DUTY_A";
PWM1.timer.$assign        = "Timer_A2";
PWM1.timer.pwmPin.$assign = "boosterpack.37";

PWM2.$name         = "CONFIG_PWM_SPEED_TOP";
PWM2.timer.$assign = "Timer_A1";

PWM3.$name                = "CONFIG_PWM_SPEED_BTN";
PWM3.timer.pwmPin.$assign = "boosterpack.31";

PWM4.$name                = "CONFIG_PWM_DUTY_B";
PWM4.timer.pwmPin.$assign = "boosterpack.3";

const Power                   = scripting.addModule("/ti/drivers/Power", {}, false);
Power.performanceLevel3.$name = "ti_drivers_power_PowerMSP432PerfLevels0";
Power.performanceLevel2.$name = "ti_drivers_power_PowerMSP432PerfLevels1";
Power.performanceLevel1.$name = "ti_drivers_power_PowerMSP432PerfLevels2";
Power.performanceLevel0.$name = "ti_drivers_power_PowerMSP432PerfLevels3";

RTOS.name = "NoRTOS";

Timer1.$name = "CONFIG_TIMER_0";

/**
 * Pinmux solution for unlocked pins/peripherals. This ensures that minor changes to the automatic solver in a future
 * version of the tool will not impact the pinmux you originally saw.  These lines can be completely deleted in order to
 * re-solve from scratch.
 */
ADC1.adc.$suggestSolution             = "ADC14";
GPIO2.gpioPin.$suggestSolution        = "P1.1.GPIO/EUSCI_A0_SPI.CLK";
GPIO3.gpioPin.$suggestSolution        = "P1.4.GPIO/EUSCI_B0_SPI.STE";
GPIO13.gpioPin.$suggestSolution       = "P2.0.GPIO/EUSCI_A1_SPI.STE";
GPIO14.gpioPin.$suggestSolution       = "P2.1.GPIO/EUSCI_A1_SPI.CLK";
GPIO15.gpioPin.$suggestSolution       = "P2.2.GPIO/EUSCI_A1_UART.RXD/EUSCI_A1_SPI.SOMI";
PWM2.timer.pwmPin.$suggestSolution    = "boosterpack.34";
PWM3.timer.$suggestSolution           = "Timer_A1";
PWM4.timer.$suggestSolution           = "Timer_A1";
RTOS.timer0.resource.$suggestSolution = "Timer_A0";
Timer1.timer.$suggestSolution         = "Timer_A3";
